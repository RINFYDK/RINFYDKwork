## conf/bblayers.conf.sample
```bitbake
#
# LAYER_CONF_VERSION is increased each time build/conf/bblayers.conf
# changes incompatibly
LCONF_VERSION = "6"

BBPATH = "${TOPDIR}"
BBFILES ?= ""
RDKROOT := "${@os.path.abspath(os.path.dirname(d.getVar('FILE', True)) + '/../..')}"

BBLAYERS ?= " \
  ${RDKROOT}/meta \
  ${RDKROOT}/meta-rdk \
  ${RDKROOT}/meta-qt5 \
  ${RDKROOT}/meta-browser \
  ${RDKROOT}/meta-java \
  ${RDKROOT}/meta-openembedded/meta-webserver \
  ${RDKROOT}/meta-openembedded/meta-multimedia \
  ${RDKROOT}/meta-openembedded/meta-filesystems \
  ${RDKROOT}/meta-openembedded/meta-oe \
  ${RDKROOT}/meta-openembedded/meta-networking \
  ${RDKROOT}/meta-openembedded/meta-ruby \
  ${RDKROOT}/meta-linaro/meta-linaro \
  ${RDKROOT}/meta-linaro/meta-linaro-toolchain \
  "

# CPC requires dedicated licenses, we need to support build when CPC is not
# available. So we only add meta-rdk-comcast layer if it exists locally.
BBLAYERS =+ "${@'${RDKROOT}/meta-rdk-comcast' if os.path.isfile('${RDKROOT}/meta-rdk-comcast/conf/layer.conf') else ''}"
#BBLAYERS += "${@'${RDKROOT}/meta-virtualization' if os.path.isfile('${RDKROOT}/meta-virtualization/conf/layer.conf') else ''}"
BBLAYERS += "${@'${RDKROOT}/meta-rdk-restricted' if os.path.isfile('${RDKROOT}/meta-rdk-restricted/conf/layer.conf') else ''}"
```

## conf/distro/include/rdk-rpi.inc
```bitbake
QEMUVER_jethro = "2.4.0"
QEMUVER_krogoth = "2.5.0"

PREFERRED_VERSION_lighttpd = "1.5%"
PREFERRED_VERSION_dbus_jethro = "1.8.%"
PREFERRED_VERSION_dbus_krogoth = "1.10.%"

PREFERRED_VERSION_libnetfilter-conntrack = "1.0.4"
PREFERRED_VERSION_net-snmp = "5.7.3"
PREFERRED_PROVIDER_libevent = "libevent"

PREFERRED_VERSION_iksemel = "1.5"
PREFERRED_VERSION_libsoup-2.4_krogoth ?= "2.52.%"
PREFERRED_VERSION_systemd_krogoth = "216%"

PREFERRED_VERSION_gstreamer1.0_krogoth = "1.6.3"
PREFERRED_VERSION_gstreamer1.0-plugins-base_krogoth = "1.6.3"
PREFERRED_VERSION_gstreamer1.0-plugins-bad_krogoth = "1.6.3"
PREFERRED_VERSION_gstreamer1.0-plugins-good_krogoth = "1.6.3"
PREFERRED_VERSION_gstreamer1.0-plugins-ugly_krogoth = "1.6.3"

PREFERRED_VERSION_breakpad = "git"

IMAGE_FSTYPES_DEBUGFS = "tar.gz"

BBMASK .= "|meta-rdk/recipes-rdkb/tdkb/tdk-b.bb"
BBMASK .= "|openembedded-core/meta/recipes-core/dbus/dbus_1.4.14.bb"
BBMASK .= "|openembedded-core/meta/recipes-devtools/gcc/gcc-source_4.8.bb"
```

## conf/machine/raspberrypi-rdk-hybrid.conf
```bitbake
# ============================================================================
# RDK MANAGEMENT, LLC CONFIDENTIAL AND PROPRIETARY
# ============================================================================
# This file (and its contents) are the intellectual property of RDK Management, LLC.
# It may not be used, copied, distributed or otherwise disclosed in whole or in
# part without the express written permission of RDK Management, LLC.
# ============================================================================
# Copyright (c) 2016 RDK Management, LLC. All rights reserved.
# ============================================================================
#@TYPE: Machine
#@NAME: raspberrypi-rdk-hybrid
#@NEEDED_BSPLAYERS: meta-cmf-raspberrypi
#@DESCRIPTION: Machine configuration for running a RDK media server (hybrid) on Raspberry Pi
#@RDK_FLAVOR: rdkv

require conf/machine/raspberrypi2.conf

MACHINEOVERRIDES =. "raspberrypi2:hybrid:"

DISTRO_CODENAME = "krogoth"

# required for image creation
MACHINE_IMAGE_NAME = "rdk-generic-hybrid-wpe-image"
PROJECT_BRANCH = "default"

PREFERRED_PROVIDER_virtual/devicesettings-hal = "devicesettings-hal-emulator"
PREFERRED_PROVIDER_virtual/gst-plugins-playersinkbin = "gst-plugins-playersinkbin-noop"

# WPE requires GCC 5.x compilers
GCCVERSION_armv7a = "linaro-5.2%"
SDKGCCVERSION_armv7a  = "linaro-5.2%"
RDK_GDB_VERSION_armv7a = "linaro-7.8%"
```

## conf/machine/raspberrypi3-64-rdk-broadband.conf
```bitbake
# ============================================================================
# RDK MANAGEMENT, LLC CONFIDENTIAL AND PROPRIETARY
# ============================================================================
# This file (and its contents) are the intellectual property of RDK Management, LLC.
# It may not be used, copied, distributed or otherwise disclosed in whole or in
# part without the express written permission of RDK Management, LLC.
# ============================================================================
# Copyright (c) 2016 RDK Management, LLC. All rights reserved.
# ============================================================================
#@TYPE: Machine
#@NAME: raspberrypi3-64-rdk-broadband
#@NEEDED_BSPLAYERS: meta-cmf-raspberrypi
#@DESCRIPTION: Machine configuration for running a RDK broadband on Raspberry Pi 3 in 64bits
#@RDK_FLAVOR: rdkb

include conf/machine/raspberrypi3-64.conf

MACHINEOVERRIDES .= ":raspberrypi3-64:broadband"

DISTRO_CODENAME = "##OE_DISTRO##"
# required for image creation
MACHINE_IMAGE_NAME = "rdkb-generic-broadband-image"
PROJECT_BRANCH = "default"

PREFERRED_VERSION_linux-raspberrypi_aarch64 = "4.7.%"

# customize our toolchain for GCC 5.x Xcompilers
GCCVERSION_aarch64 = "linaro-5.2%"
SDKGCCVERSION_aarch64 = "linaro-5.2%"
RDK_GDB_VERSION_aarch64 = "linaro-7.8%"

SERIAL_CONSOLE = "115200 ttyS0"
```

## meta-cmf-raspberrypi/conf/layer.conf
```bitbake
BBPATH .= ":${LAYERDIR}"
BBFILES += "\
            ${LAYERDIR}/recipes-*/*/*.bb \
            ${LAYERDIR}/recipes-*/*/*.bbappend \
           "

BBFILE_COLLECTIONS += "cmf-raspberrypi"
BBFILE_PATTERN_cmf-raspberrypi := "^${LAYERDIR}/"
#BBFILE_PRIORITY_cmf-raspberrypi = "24"

# do not error out on bbappends for missing recipes (mysql5)
#BB_DANGLINGAPPENDS_WARNONLY = "true"

LAYERDEPENDS_cmf-raspberrypi = "${@'cmf-rdkb' if "broadband" in d.getVar('MACHINEOVERRIDES', True) else 'cmf'}"
LAYERDEPENDS_cmf-raspberrypi_append = "${@' ' if "broadband" in d.getVar('MACHINEOVERRIDES', True) else ' metrological'}"
LAYERDEPENDS_cmf-raspberrypi_append = " raspberrypi"

include include/rdk-bbmasks-##RDK_FLAVOR##-platform.inc
```

## meta-cmf-raspberrypi/conf/machine/raspberrypi-rdk-broadband.conf
```bitbake
# ============================================================================
# RDK MANAGEMENT, LLC CONFIDENTIAL AND PROPRIETARY
# ============================================================================
# This file (and its contents) are the intellectual property of RDK Management, LLC.
# It may not be used, copied, distributed or otherwise disclosed in whole or in
# part without the express written permission of RDK Management, LLC.
# ============================================================================
# Copyright (c) 2016 RDK Management, LLC. All rights reserved.
# ============================================================================
#@TYPE: Machine
#@NAME: raspberrypi-rdk-broadband
#@NEEDED_BSPLAYERS: meta-cmf-raspberrypi
#@DESCRIPTION: Machine configuration for running a RDK broadband on Raspberry Pi
#@RDK_FLAVOR: rdkb

include conf/machine/raspberrypi3.conf

MACHINEOVERRIDES .= ":raspberrypi3:broadband"

DISTRO_CODENAME = "##OE_DISTRO##"
# required for image creation
MACHINE_IMAGE_NAME = "rdkb-generic-broadband-image"
PROJECT_BRANCH = "default"

# customize our toolchain for GCC 5.x Xcompilers
GCCVERSION_armv7a = "linaro-5.2%"
SDKGCCVERSION_armv7a = "linaro-5.2%"
RDK_GDB_VERSION_armv7a = "linaro-7.8%"

SERIAL_CONSOLE = "115200 ttyAMA0"
```
